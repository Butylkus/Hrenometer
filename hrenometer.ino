/*
Хренометр 191113-1
by AlexGyver & Butylkus
Вычислялки и сенсорика в основном Гайвер, свистоперделки и немного оптимизации - Бутылкус.
*/

#include <SPI.h>
#include <Adafruit_GFX.h>
#include <Adafruit_PCD8544.h>


int set;
boolean initial;         //флаг первого пуска
int n=1;                 //номер выстрела, начиная с 1
float velocity, energy;  //переменные скорости и энергии
float mass=0.67;         //масса снаряда в граммах
float dist=0.124;        //расстояние между датчиками в метрах  
volatile unsigned long gap1, gap2;    //отметки времени прохождения пулей датчиков



// Hardware SPI (Потому что ниибаца быстрее софтверного):
// LCD serial clock (SCLK) - D13 на Uno
// LCD DIN - D11 на Uno
// D5 - Data/Command (D/C)
// D7 - chip select (CS)
// D6 - reset (RST)
// уотакуот, потому что на дефолтных пинах либы (3й сто процентов) висят прерывания
Adafruit_PCD8544 display = Adafruit_PCD8544(5, 7, 6);


//оверлей Хренометра - лого
const unsigned char PROGMEM logo [] = {
0x00, 0x00, 0x00, 0x00, 0x00, 0x00, 0x00, 0x00, 0x00, 0x00, 0x00, 0x00, 0x00, 0x0f, 0x81, 0xf8, 
0xe0, 0xe0, 0x00, 0x00, 0x00, 0x00, 0x70, 0x00, 0x1f, 0xc7, 0x3c, 0xf0, 0xe3, 0xff, 0xe0, 0x00, 
0x00, 0x78, 0x38, 0x71, 0xe7, 0x00, 0x70, 0xe3, 0x80, 0xf0, 0x00, 0x00, 0x38, 0x78, 0x70, 0xe7, 
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0x00, 0x07, 0x00, 0x00, 0x00, 0x01, 0x00, 0x00, 0x00, 0x00, 0x00, 0x00, 0x00, 0x00, 0x00, 0x00
};

// ещё оверлей - подложка под показания
const unsigned char PROGMEM overlay [] = {
0x00, 0x00, 0x00, 0x00, 0x00, 0x00, 0x00, 0x00, 0x00, 0x00, 0x00, 0x00, 0x00, 0x00, 0x00, 0x00, 
0x00, 0x00, 0x00, 0x00, 0x00, 0x00, 0x00, 0x00, 0x00, 0x00, 0x00, 0x00, 0x00, 0x00, 0x00, 0x00, 
0x00, 0x00, 0x00, 0x00, 0x00, 0x00, 0x00, 0x00, 0x00, 0x00, 0x00, 0x00, 0x00, 0x00, 0x00, 0x00, 
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0x20, 0x03, 0x40, 0x00, 0x00, 0x00, 0x00, 0x00, 0x00, 0x00, 0x00, 0x00, 0x00, 0x00, 0x00, 0x00
};


// Ви таки не повегите - ещё одна картинка! Кажет "фейл" при кривой стрельбе
const unsigned char PROGMEM moloko [] = {
0x00, 0x00, 0x00, 0x00, 0x00, 0x00, 0x00, 0x00, 0x00, 0x00, 0x00, 0x00, 0x00, 0x02, 0x00, 0x00, 
0x00, 0x00, 0x00, 0x00, 0x00, 0x00, 0x00, 0x00, 0x02, 0x00, 0x00, 0x00, 0x00, 0x00, 0x00, 0x00, 
0x00, 0x00, 0x00, 0x02, 0x00, 0x00, 0x00, 0x00, 0x00, 0x00, 0x00, 0x00, 0x00, 0x00, 0x02, 0x00, 
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0x00, 0x03, 0x00, 0x00, 0x00, 0xff, 0xff, 0xff, 0x00, 0x00, 0x00, 0x00, 0x02, 0x00, 0x00, 0x00
};



void setup() {
	Serial.begin(9600);               //открываем COM-порт
	attachInterrupt(1,start,RISING);  //аппаратное прерывание при прохождении первого датчика
	attachInterrupt(0,finish,RISING); //аппаратное прерывание при прохождении второго датчика

  display.begin();                  //включаем в работу дисплей
  display.setContrast(60);          //тут надо поиграться, многое зависит от модели и чуть ли не фазы луны
 
}

void ShowLogo(){
  display.clearDisplay();
  display.drawBitmap(0,0,logo,84,48,1);
  display.display();

}

void ShowResult(){
  display.clearDisplay();
  display.setTextColor(BLACK);
  display.drawBitmap(0,0,overlay,84,48,1);
  

  //Last bullet speed
  display.setTextSize(3);
  display.setCursor(0,0);
  display.println(round(velocity)); // если там 100+, то можно забить на десятые, это уже неважно
  energy = (sq(velocity)*mass)/2000;  //классическое эмвэквадратпополам, только тыщу раз пополам, ибо килограммы
  display.setTextSize(2);
  display.setCursor(0,30);
  display.print(energy);
  display.display();
}

void ShowFail(){
  display.clearDisplay();
  display.drawBitmap(0,0,moloko,84,48,1);
  display.display();
  delay(2000);
  ShowLogo();
}


void start(){
	if (gap1==0) {   //если измерение еще не проводилось
		gap1=micros(); //получаем время первой отсечки
	}
}

void finish() {
	if (gap2==0) {    //если измерение еще не проводилось
		gap2=micros();  //получаем время второй отсечки
	}
}

void loop() {
	if (initial==0) {                                         //флажок первого запуска
		Serial.println("Press 1 to service mode");              //режим отладки (резисторы)
		Serial.println("Press 0 speed measure mode (default)"); //выход из режимов
		Serial.println("System is ready");                      //уведомление о том, что хрон готов к работе
		Serial.println(" ");
		initial=1;                                              //первый запуск, больше не показываем сообщения
    ShowLogo();                                             // на экране лого
	}

	if (Serial.available() > 0 && set!=2) {   //если есть какие буквы на входе с порта
		int val=Serial.read();                  //прочитать что было послано в порт
		switch(val) {                           //оператор выбора

		case 48: set=0; initial=0; break;       //если приняли 0 то выбрать 0 режим
		case 49: set=1; break;                  //если приняли 1 то запустить режим 1
		}
	}

// режим калибровки датчиков. За подробностями к Гайверу.
	if (set==1) {                       //если 1 режим
	  	Serial.print("sensor 1: ");
	  	Serial.println(analogRead(2));  //показать значение на первом датчике
      Serial.print("sensor 2: ");
      Serial.println(analogRead(4));  //показать значение на первом датчике
	  	Serial.println();        
    
	}


	if (gap1!=0 && gap2!=0 && gap2>gap1 && set==0) {  //если пуля прошла оба датчика в 0 режиме
		velocity=(1000000*(dist)/(gap2-gap1));          //вычисление скорости
    ShowResult();                                   //показываем результат на экране
		Serial.print("Shot #");                        
		Serial.println(n);                              //вывод номера выстрела
		Serial.print("Speed: ");    
		Serial.println(velocity);                       //вывод скорости в COM
		Serial.print("Energy: ");    
		Serial.println(energy);                         //вывод энергии в COM
		Serial.println(" "); 
		gap1=0;                                         //сброс значений
		gap2=0;
		n++;                                            //номер выстрела +1
	}

	if (micros()-gap1>1000000 && gap1!=0 && set!=1) { // (если пуля прошла первый датчик) И (прошла уже 1 секунда, а второй датчик не тронут)
		Serial.println("FAIL");                         //выдаёт FAIL через 1 секунду, если пуля прошла через первый датчик, а через второй нет
    ShowFail();                                     // показываем ошибку на экране
		gap1=0;
		gap2=0;
	}

	delay(100);  //задержка для стабильности. Если убрать, экран будет обновляться постоянно.
}
